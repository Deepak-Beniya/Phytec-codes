## Module4/new_board_u-boot/u-boot-2018.07/board/atmel/Jb_board/Kconfig
```kconfig
if TARGET_JB_BOARD

config SYS_BOARD
	default "Jb_board"

config SYS_VENDOR
	default "atmel"

config SYS_SOC
	default "at91"

config SYS_CONFIG_NAME
	default "Jb_board"

endif
```
